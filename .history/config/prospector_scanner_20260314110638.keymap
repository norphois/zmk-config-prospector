// Basic import
#include <behaviors.dtsi>
#include <dt-bindings/zmk/keys.h>
#include <dt-bindings/zmk/bt.h>
#include <dt-bindings/zmk/outputs.h>

// Layers
#define DEFAULT 0
#define MACOS   1
#define NUMBER  2
#define SYSCTL  3
#define ADJUST  4
#define UMLAUT  5

/ {
    keymap {
        compatible = "zmk,keymap";

                // ── Layer 0: DEFAULT ─────────────────────────────────────────
                default_layer {
                    display-name = "Base";
                        bindings = <
                        <&none>
                        >;
                };

        };
};
